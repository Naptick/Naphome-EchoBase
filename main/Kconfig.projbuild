## main/Kconfig.projbuild
```kconfig
menu "Korvo1 LED Audio Test"

config LED_AUDIO_STRIP_GPIO
    int "WS2812 data GPIO"
    default 19
    help
        GPIO that feeds the built-in Korvo WS2812 ring. GPIO19 is routed to the
        factory LED chain on Korvo-1 production boards.

config LED_AUDIO_LED_COUNT
    int "Number of pixels"
    default 12
    range 1 64
    help
        Total number of addressable LEDs on the Korvo-1 ring.

config LED_AUDIO_BRIGHTNESS
    int "Brightness (0-255)"
    default 64
    range 1 255
    help
        Global brightness scalar applied to every RGB value before writing it to the strip.

config AUDIO_SAMPLE_RATE
    int "Audio sample rate (Hz)"
    default 44100
    range 8000 48000
    help
        Sample rate for audio playback.

config LOG_SWEEP_DURATION_SEC
    int "Log sweep duration (seconds)"
    default 5
    range 1 30
    help
        Duration of the logarithmic frequency sweep test tone.

config LOG_SWEEP_START_FREQ
    int "Log sweep start frequency (Hz)"
    default 20
    range 20 20000
    help
        Starting frequency for the logarithmic sweep.

config LOG_SWEEP_END_FREQ
    int "Log sweep end frequency (Hz)"
    default 20000
    range 20 20000
    help
        Ending frequency for the logarithmic sweep.

endmenu
```

## sdkconfig.defaults
```kconfig
CONFIG_LED_AUDIO_STRIP_GPIO=19
CONFIG_LED_AUDIO_LED_COUNT=12
CONFIG_LED_AUDIO_BRIGHTNESS=64
CONFIG_AUDIO_SAMPLE_RATE=44100
CONFIG_LOG_SWEEP_DURATION_SEC=5
CONFIG_LOG_SWEEP_START_FREQ=20
CONFIG_LOG_SWEEP_END_FREQ=20000
# Use 16MB flash (KORVO1 has 16MB flash)
CONFIG_ESPTOOLPY_FLASHSIZE_16MB=y
CONFIG_ESPTOOLPY_FLASHSIZE="16MB"
# Use custom partition table to fit embedded WAV file
CONFIG_PARTITION_TABLE_CUSTOM=y
CONFIG_PARTITION_TABLE_CUSTOM_FILENAME="partitions.csv"
CONFIG_PARTITION_TABLE_SINGLE_APP_LARGE=n
CONFIG_PARTITION_TABLE_SINGLE_APP=n

# Gemini API Configuration (from sample/voice assistant)
CONFIG_GEMINI_API_KEY="AIzaSyCjrdIBkpGWGXa4u9UileFFIMBZ_ZnMZ1w"
CONFIG_GEMINI_MODEL="gemini-2.5-flash"

# WiFi Configuration
CONFIG_WIFI_SSID="The Chateau"
CONFIG_WIFI_PASSWORD="thechateau"

# Note: ESP32-S3 has embedded PSRAM (8MB) which is automatically available
# No special configuration needed - malloc() will use it automatically
```

## sdkconfig.defaults.korvo1
```kconfig
# Korvo1 board configuration defaults
# This file contains board-specific ESP-IDF configuration for Korvo1

CONFIG_BOARD_KORVO1=y

# Korvo1 uses 16 MB flash
CONFIG_ESPTOOLPY_FLASHSIZE=16MB

# Partition table configuration
CONFIG_PARTITION_TABLE_CUSTOM=y
CONFIG_PARTITION_TABLE_CUSTOM_FILENAME="partitions.csv"

# Audio configuration
CONFIG_AUDIO_SAMPLE_RATE=44100
CONFIG_LOG_SWEEP_DURATION_SEC=5
CONFIG_LOG_SWEEP_START_FREQ=20
CONFIG_LOG_SWEEP_END_FREQ=20000

# LED configuration
CONFIG_LED_AUDIO_STRIP_GPIO=19
CONFIG_LED_AUDIO_LED_COUNT=12
CONFIG_LED_AUDIO_BRIGHTNESS=64

# Common ESP-IDF settings
CONFIG_ESP_DEFAULT_CPU_FREQ_MHZ=240
CONFIG_ESP_WIFI_AUTH_WPA2_PSK_SHA256=y
CONFIG_LWIP_IPV6=y

# Logging
CONFIG_LOG_DEFAULT_LEVEL=2
```

## sdkconfig.defaults.m5
```kconfig
# M5 Atom Echo Base configuration defaults
# This file contains board-specific ESP-IDF configuration for M5 Atom S3R + Echo Base

CONFIG_BOARD_M5_ECHO_BASE=y

# M5 Atom S3R: ESP32-S3-PICO-1 with 8MB embedded flash + 8MB PSRAM
# Note: Echo Base adds 4MB on-chip storage (not primary)
CONFIG_ESPTOOLPY_FLASHSIZE=8MB

# Partition table configuration
CONFIG_PARTITION_TABLE_CUSTOM=y
CONFIG_PARTITION_TABLE_CUSTOM_FILENAME="partitions_m5.csv"

# Audio configuration
# Echo Base optimized for voice assistant (16 kHz STT)
CONFIG_AUDIO_SAMPLE_RATE=16000
CONFIG_LOG_SWEEP_DURATION_SEC=3
CONFIG_LOG_SWEEP_START_FREQ=100
CONFIG_LOG_SWEEP_END_FREQ=5000

# LED configuration
# M5 Echo Base has single SK6812 LED on GPIO 46
# For feature parity, can add external WS2812 ring on Atom S3R
CONFIG_LED_AUDIO_STRIP_GPIO=46
CONFIG_LED_AUDIO_LED_COUNT=1
CONFIG_LED_AUDIO_BRIGHTNESS=128

# Common ESP-IDF settings
CONFIG_ESP_DEFAULT_CPU_FREQ_MHZ=240
CONFIG_ESP_WIFI_AUTH_WPA2_PSK_SHA256=y
CONFIG_LWIP_IPV6=y

# USB Serial JTAG Console (works immediately on boot)
# USB CDC also available as secondary console
CONFIG_ESP_CONSOLE_USB_SERIAL_JTAG=y
CONFIG_ESP_CONSOLE_SECONDARY_USB_CDC=y

# Logging (reduced for smaller flash)
CONFIG_LOG_DEFAULT_LEVEL=1

# Memory optimization for 4MB flash
CONFIG_NEWLIB_NANO_FORMAT=y

# Reduce partition sizes
CONFIG_ESP_PARTITION_TABLE_OFFSET=0x8000

# Optional: PSRAM configuration (if available)
# CONFIG_SPIRAM=y
# CONFIG_SPIRAM_MODE_QUAD=y
# CONFIG_SPIRAM_TYPE_ESP3216=y
```
